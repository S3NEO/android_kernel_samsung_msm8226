/* Copyright (c) 2013, The Linux Foundation. All rights reserved.
 *
 * This program is free software; you can redistribute it and/or modify
 * it under the terms of the GNU General Public License version 2 and
 * only version 2 as published by the Free Software Foundation.
 *
 * This program is distributed in the hope that it will be useful,
 * but WITHOUT ANY WARRANTY; without even the implied warranty of
 * MERCHANTABILITY or FITNESS FOR A PARTICULAR PURPOSE.  See the
 * GNU General Public License for more details.
 */

&mdss_mdp {
	dsi_boe_hd_vid: qcom,mdss_dsi_boe_hd_video {
		qcom,mdss-dsi-panel-name = "BOE HD video mode dsi SEC_S6D7AA0 panel";
		qcom,mdss-dsi-panel-controller = <&mdss_dsi0>;
		qcom,mdss-dsi-panel-type = "dsi_video_mode";
		qcom,oled-esd-gpio = <&msmgpio 54 0>;
		qcom,mdss-dsi-panel-destination = "display_1";
		qcom,mdss-dsi-panel-framerate = <60>;
		qcom,mdss-dsi-panel-clock-rate = <416000000>;
		qcom,mdss-dsi-virtual-channel-id = <0>;
		qcom,mdss-dsi-stream = <0>;
		qcom,mdss-dsi-panel-width = <720>;
		qcom,mdss-dsi-panel-height = <1280>;
		qcom,mdss-pan-size = <77 124>; /* <Width> <Height> real size of panel in mm */
		qcom,mdss-dsi-h-back-porch = <50>;
		qcom,mdss-dsi-h-front-porch = <100>;
		qcom,mdss-dsi-h-pulse-width = <16>;
		qcom,mdss-dsi-h-sync-skew = <0>;
		qcom,mdss-dsi-v-back-porch = <8>;
		qcom,mdss-dsi-v-front-porch = <8>;
		qcom,mdss-dsi-v-pulse-width = <2>;
		qcom,mdss-dsi-h-left-border = <0>;
		qcom,mdss-dsi-h-right-border = <0>;
		qcom,mdss-dsi-v-top-border = <0>;
		qcom,mdss-dsi-v-bottom-border = <0>;
		qcom,mdss-dsi-bpp = <24>;
		qcom,mdss-dsi-color-order = <0>;
		qcom,mdss-dsi-underflow-color = <0xff>;
		qcom,mdss-dsi-border-color = <0>;
		qcom,mdss-dsi-mdp-trigger = <0x0>;
		qcom,mdss-dsi-dma-trigger = <0x04>;
		qcom,mdss-dsi-bl-min-level = <1>;
		qcom,mdss-dsi-bl-max-level = <255>;
		qcom,mdss-dsi-bl-pmic-control-type = "bl_ctrl_dcs";
		qcom,mdss-pan-dsi-t-clk-pre = <0x1b>;
		qcom,mdss-pan-dsi-t-clk-post = <0x04>;
		qcom,mdss-dsi-lane-0-state;
		qcom,mdss-dsi-lane-1-state;
		qcom,mdss-dsi-lane-2-state;
		qcom,mdss-dsi-lane-3-state;
		qcom,mdss-dsi-bllp-eof-power-mode;
		qcom,mdss-dsi-bllp-power-mode;
		qcom,mdss-dsi-traffic-mode = <2>;
		qcom,mdss-force-clk-lane-hs = <1>;
		qcom,mdss-dsi-lane-map = <0>;
		qcom,mdss-dsi-h-sync-pulse = <0>;
		
		qcom,panel-phy-regulatorSettings = [03 0a 04 00  /* Regualotor settings */
						20 00 01];
		qcom,panel-phy-timingSettings = [33 24 18 00 42 4C 18 24 15 03 04 00];
		qcom,panel-phy-strengthCtrl = [ff 06];
		qcom,panel-phy-bistCtrl = [00 00 b1 ff           /* BIST Ctrl settings */
						00 00];
		qcom,panel-phy-laneConfig = [
						00 c2 45 00 00 00 00 01 75 /* lane0 config */
						00 c2 45 00 00 00 00 01 75 /* lane1 config */
						00 c2 45 00 00 00 00 01 75 /* lane2 config */
						00 c2 45 00 00 00 00 01 75 /* lane3 config */
						00 02 45 00 00 00 00 01 97]; /* Clk ln config */

		qcom,mdss-dsi-on-command = [
					39 01 00 00 00 00 03 F0 5A 5A
					39 01 00 00 00 00 03 F1 5A 5A
					39 01 00 00 00 00 03 FC A5 A5

					39 01 00 00 01 00 03 D0 00 10

					39 01 00 00 00 00 04 C3 40 00 2B
					39 01 00 00 00 00 04 BC 00 4E A2
					39 01 00 00 00 00 05 FD 16 10 11 23
					39 01 00 00 00 00 07 FE 00 02 03 21 00 70
					39 01 00 00 00 00 02 53 2C
					39 01 00 00 05 00 02 51 5F
					39 01 00 00 00 00 04 F2 02 0A 08 /* Vporch */
					39 01 00 00 00 00 04 C3 C7 00 28 /*Blu freq 12khz*/

					05 01 00 00 78 00 02 11 00

					39 01 00 00 00 00 03 F0 A5 A5
					39 01 00 00 00 00 03 F1 A5 A5
					39 01 00 00 00 00 03 FC 5A 5A

					39 01 00 00 00 00 02 35 00
					05 01 00 00 00 00 02 29 00
					];

		qcom,mdss-dsi-on-command-state = "dsi_lp_mode";

		qcom,mdss-dsi-off-command = [
					05 01 00 00 32 00 02 28 00
					39 01 00 00 05 00 04 C3 40 00 20
					05 01 00 00 00 00 02 10 00
					];
		qcom,mdss-dsi-off-command-state = "dsi_hs_mode";
	};
};
