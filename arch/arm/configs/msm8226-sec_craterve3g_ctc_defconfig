## arch/arm/configs/msm8926-sec_q7sglte_chncmcc_defconfig
```kconfig
CONFIG_SWAP=y
CONFIG_ZRAM=y
CONFIG_ZRAM_DEBUG=y
CONFIG_ZRAM_FOR_ANDROID=y

#variant defconfig
CONFIG_MACH_Q7_CHN_SGLTE=y
# CONFIG_MACH_MS01_LTE is not set

#Battery
CONFIG_QPNP_SEC_CHARGER=y
CONFIG_QPNP_BMS=y
CONFIG_BATTERY_BCL=y
CONFIG_CMCC_MTBF_CHG_BLOCK=y

#LCD
CONFIG_FB_MSM_MDSS_BOE_HD_PANEL=y
#CONFIG_ESD_ERR_FG_RECOVERY is not set
CONFIG_FB_MSM_MDSS=y
CONFIG_FB_MSM_MDSS_WRITEBACK=y
CONFIG_BACKLIGHT_LCD_SUPPORT=y
#CONFIG_MDNIE_LITE_TUNING is not set
#CONFIG_MDNIE_VIDEO_ENHANCED is not set
CONFIG_TCON_MDNIE_LITE=y
CONFIG_LCD_CLASS_DEVICE=y
CONFIG_BACKLIGHT_CLASS_DEVICE=y
#CONFIG_BACKLIGHT_GENERIC is not set
CONFIG_LCD_CONNECTION_CHECK=y

#TOUCH
CONFIG_TOUCHSCREEN_MMS152=n
CONFIG_TOUCHSCREEN_BCMTCH15XXX=n
CONFIG_KEYBOARD_CYPRESS_TOUCH=n
CONFIG_TOUCHSCREEN_ZINITIX_BT531=n
CONFIG_TOUCHSCREEN_ATMEL_MXTS=n
CONFIG_KEYBOARD_CYPRESS_TOUCH_20234=n
CONFIG_TOUCHSCREEN_ZINITIX_Q7=y

#Vibrator
CONFIG_MSM_VIBRATOR=y
CONFIG_QPNP_VIBRATOR=y

#HallSensor
CONFIG_SENSORS_HALL=n

#USB
CONFIG_USB_ANDROID_SAMSUNG_COMPOSITE=y
CONFIG_USB_ANDROID_SAMSUNG_MTP=y
CONFIG_USB_HOST_NOTIFY=y
CONFIG_USB_DUN_SUPPORT=y


#MUIC
# CONFIG_USB_SWITCH_TSU6721 is not set
CONFIG_USB_SWITCH_RT8973=y

#SENSORS
CONFIG_SENSORS_CORE=y
CONFIG_SENSOR_USE_SYMLINK=y
#CONFIG_SENSORS_K2HH=y
CONFIG_SENSORS_HSCDTD008A=y
CONFIG_SENSORS_TMD27723=y
CONFIG_SENSORS_SX9500=y
CONFIG_SENSORS_SX9500_INIT_TOUCH_THRESHOLD=3000
CONFIG_SENSORS_SX9500_NORMAL_TOUCH_THRESHOLD=17


CONFIG_INPUT=y
CONFIG_INPUT_GPIO=y
CONFIG_INPUT_POLLDEV=y


#CAMERA
CONFIG_S5K3H5XA=y
CONFIG_S5K4H5YA=y
CONFIG_S5K4H5YB=y
CONFIG_S5K6A3YX=y

#WIFI
#no need

#BT
#no need

# Earjack
CONFIG_SAMSUNG_JACK=y

# NFC
CONFIG_BCM2079X_NFC_I2C=y

# DO NOT EXT OVP
CONFIG_NOT_USE_EXT_OVP=y

# SAPA
CONFIG_RTC_AUTO_PWRON=y
CONFIG_RTC_AUTO_PWRON_PARAM=y

# CTS
# CONFIG_IKCONFIG_PROC is not set

#SEC OOM KILLER 
CONFIG_SEC_OOM_KILLER=y

# QDSS turned off
# CONFIG_CORESIGHT is not set
# CONFIG_CORESIGHT_FUSE is not set
# CONFIG_CORESIGHT_TMC is not set
# CONFIG_CORESIGHT_TPIU is not set
# CONFIG_CORESIGHT_FUNNEL is not set
# CONFIG_CORESIGHT_REPLICATOR is not set
# CONFIG_CORESIGHT_STM is not set
# CONFIG_CORESIGHT_HWEVENT is not set
# CONFIG_CORESIGHT_ETM is not set
# CONFIG_CORESIGHT_AUDIO_ETM is not set
# CONFIG_CORESIGHT_MODEM_ETM is not set
# CONFIG_CORESIGHT_WCN_ETM is not set
# CONFIG_CORESIGHT_RPM_ETM is not set
# CONFIG_CORESIGHT_EVENT is not set
```

## arch/arm/configs/msm8926-sec_victorsglte_chncmcc_defconfig
```kconfig
CONFIG_SWAP=y
CONFIG_ZRAM=y
CONFIG_ZRAM_DEBUG=y
CONFIG_ZRAM_FOR_ANDROID=y

#variant defconfig
CONFIG_MACH_VICTOR_CHN_SGLTE=y
# CONFIG_MACH_MS01_LTE is not set

#Battery
CONFIG_QPNP_SEC_CHARGER=y
CONFIG_QPNP_BMS=y
CONFIG_BATTERY_BCL=y

#LCD
CONFIG_FB_MSM_MDSS_HX8369B_WVGA_PANEL=y
#CONFIG_ESD_ERR_FG_RECOVERY is not set
CONFIG_FB_MSM_MDSS=y
CONFIG_FB_MSM_MDSS_WRITEBACK=y
CONFIG_BACKLIGHT_LCD_SUPPORT=y
#CONFIG_MDNIE_LITE_TUNING is not set
CONFIG_MDNIE_VIDEO_ENHANCED=y
CONFIG_LCD_CLASS_DEVICE=y
CONFIG_BACKLIGHT_CLASS_DEVICE=y
CONFIG_BACKLIGHT_IC_KTD253=y
#CONFIG_BACKLIGHT_GENERIC is not set
CONFIG_LCD_CONNECTION_CHECK=y

#TOUCH
CONFIG_TOUCHSCREEN_MMS136=y
CONFIG_TOUCHSCREEN_MMS144=n
CONFIG_TOUCHSCREEN_BCMTCH15XXX=n
CONFIG_KEYBOARD_CYPRESS_TOUCH=n
CONFIG_TOUCHSCREEN_ZINITIX_BT531=n
CONFIG_TOUCHSCREEN_ATMEL_MXTS=n
CONFIG_KEYBOARD_CYPRESS_TOUCH_20234=n

#Vibrator
CONFIG_MSM_VIBRATOR=y
CONFIG_QPNP_VIBRATOR=y

#HallSensor
CONFIG_SENSORS_HALL=n

#USB
CONFIG_USB_ANDROID_SAMSUNG_COMPOSITE=y
CONFIG_USB_ANDROID_SAMSUNG_MTP=y
CONFIG_USB_HOST_NOTIFY=y
CONFIG_USB_DUN_SUPPORT=y


#MUIC
# CONFIG_USB_SWITCH_TSU6721 is not set
CONFIG_USB_SWITCH_RT8973=y

#SENSORS
CONFIG_SENSORS_CORE=y
CONFIG_INPUT_YAS_SENSORS=n
CONFIG_YAS_ACC_MULTI_SUPPORT=n
CONFIG_INPUT_YAS_ACCELEROMETER=n
CONFIG_YAS_ACC_DRIVER_BMA250=n
CONFIG_INPUT_YAS_ACCELEROMETER_POSITION=1
# CONFIG_SENSORS_HSCDTD008A is not set
CONFIG_INPUT=y
CONFIG_INPUT_GPIO=y
CONFIG_INPUT_POLLDEV=y
# CONFIG_INPUT_MPU6500 is not set
# CONFIG_INPUT_MPU6500_SELFTEST is not set
# CONFIG_INPUT_MPU6500_POLLING is not set
CONFIG_OPTICAL_TAOS=y
CONFIG_BMA250_ACC_DRIVER=y

#CAMERA
CONFIG_S5K3H5XA=y
CONFIG_S5K4H5YA=y
CONFIG_S5K4H5YB=y
CONFIG_S5K6A3YX=y
CONFIG_S5K4ECGX=y

#WIFI
#no need

#BT
#no need

# Earjack
CONFIG_SAMSUNG_JACK=y

# NFC
CONFIG_BCM2079X_NFC_I2C=y

# DO NOT EXT OVP
CONFIG_NOT_USE_EXT_OVP=y

# SAPA
CONFIG_RTC_AUTO_PWRON=y
CONFIG_RTC_AUTO_PWRON_PARAM=y

# CTS
# CONFIG_IKCONFIG_PROC is not set

#SEC OOM KILLER 
CONFIG_SEC_OOM_KILLER=y

# QDSS turned off
# CONFIG_CORESIGHT is not set
# CONFIG_CORESIGHT_FUSE is not set
# CONFIG_CORESIGHT_TMC is not set
# CONFIG_CORESIGHT_TPIU is not set
# CONFIG_CORESIGHT_FUNNEL is not set
# CONFIG_CORESIGHT_REPLICATOR is not set
# CONFIG_CORESIGHT_STM is not set
# CONFIG_CORESIGHT_HWEVENT is not set
# CONFIG_CORESIGHT_ETM is not set
# CONFIG_CORESIGHT_AUDIO_ETM is not set
# CONFIG_CORESIGHT_MODEM_ETM is not set
# CONFIG_CORESIGHT_WCN_ETM is not set
# CONFIG_CORESIGHT_RPM_ETM is not set
# CONFIG_CORESIGHT_EVENT is not set
# CONFIG_MDNIE_LITE_TUNING is not set
```

## drivers/sensors/Kconfig
```kconfig
config SENSORS_CORE
         bool "sensors_core"
         depends on I2C

config SENSORS_K2HH
	depends on I2C
	tristate "SENSORS_K2HH"
	default n
	help
	  Say Y here if you use SENSORS_K2HH.
	  This option enables accelerometer sensors using
	  STMicroelectronic K2HH device driver.

config SENSORS_SX9500
	depends on I2C
	tristate "SX9500 driver"
	default n
	help
	  Say Y here if you use sx9500.
	  This option enables grip sensors using
	  SemTech sx9500 device driver.

	  Say N here if you do not use sx9500.

config SENSORS_SX9500_INIT_TOUCH_THRESHOLD
	int "SX9500 Grip sensor threshold for init touch"
	depends on SENSORS_SX9500
	default "3000"
	help
	  This value is the standard of init touch using
	  SemTech sx9500 device driver.

config SENSORS_SX9500_NORMAL_TOUCH_THRESHOLD
	int "SX9500 Grip sensor threshold for normal touch"
	depends on SENSORS_SX9500
	default "17"
	help
	  This value is the standard of normal touch using
	  SemTech sx9500 device driver.

config SENSOR_USE_SYMLINK
         bool "sensors_symlink"
         depends on I2C

config SENSORS_HSCDTD008A
	depends on I2C
	tristate "hscd alps HSCDTD008A"
	default n
	help
	  This option enables hscd alps HSCDTD008A mag driver

config SENSORS_TMD27723
	depends on I2C
	tristate "TMD27723 driver"
	default n
	help
	   This option enables proximity & light sensors using TMD27723 driver.

source "drivers/sensors/optical/Kconfig"
source "drivers/sensors/mpu6500/Kconfig"
source "drivers/sensors/accelerometer_k2dh/Kconfig"
source "drivers/sensors/grip_sensor/Kconfig"
source "drivers/sensors/accelerometer/Kconfig"
source "drivers/sensors/accelerometer_bma250/Kconfig"
source "drivers/sensors/geomagnetic/Kconfig"
```

## drivers/video/msm/mdss/Kconfig
```kconfig
config FB_MSM_MDSS_WRITEBACK
	bool "MDSS Writeback Panel"
	---help---
	The MDSS Writeback Panel provides support for routing the output of
	MDSS frame buffer driver and MDP processing to memory.

config FB_MSM_MDSS_HDMI_PANEL
	depends on FB_MSM_MDSS
	bool "MDSS HDMI Tx Panel"
	default n
	---help---
	The MDSS HDMI Panel provides support for transmitting TMDS signals of
	MDSS frame buffer data to connected hdmi compliant TVs, monitors etc.

config FB_MSM_MDSS_HDMI_MHL_SII8334
	depends on FB_MSM_MDSS_HDMI_PANEL
	bool 'MHL SII8334 support '
	default n
	---help---
	  Support the HDMI to MHL conversion.
	  MHL (Mobile High-Definition Link) technology
	  uses USB connector to output HDMI content

config MDNIE_VIDEO_ENHANCED
	bool "MDNIe video enhanced tuning"
	default n
config FB_MSM_MDSS_DSI_CTRL_STATUS
	tristate "DSI controller status check feature"
	---help---
	  Check DSI controller status periodically (default period is 5
	  seconds) by sending Bus-Turn-Around (BTA) command. If DSI controller
	  fails to acknowledge the BTA command, it sends PANEL_ALIVE=0 status
	  to HAL layer to reset the controller.
	  
config MDNIE_LITE_TUNING
	bool "MDNIe lite panel tuning"
	default n

config FB_MSM_MDSS_SHARP_HD_PANEL
	bool "MDSS SHARP HD Panel"
	default n
	---help---
	The MDSS SHARP LCD Panel support

config FB_MSM_MDSS_MAGNA_WVGA_PANEL
	bool "MDSS MAGNA WVGA Panel"
	default n
	---help---
	The MDSS MAGNA LCD Panel support
	
config FB_MSM_MDSS_HX8369B_WVGA_PANEL
	bool "MDSS HX8369B WVGA Panel"
	default n
	---help---
	The MDSS HX8369B LCD Panel support
	
config BACKLIGHT_IC_KTD253
	bool "BACKLIGHT IC KTD253"
	default n
	---help---
	The BACKLIGHT IC KTD253 support
	
config FB_MSM_MDSS_MAGNA_OCTA_720P_PANEL
	bool "MDSS MAGNA OCTA 720P Panel"
	default n
	---help---
	The MDSS MAGNA OCTA Panel support
	
config FB_MSM_MDSS_S6E8AA0A_HD_PANEL
	bool "MDSS S6E8AA0A HD Panel"
	default n
	---help---
	The MDSS S6E8AA0A LCD Panel support

config FB_MSM_MDSS_HIMAX_QHD_PANEL
	bool "MDSS HIMAX QHD Panel"
	default n
	---help---
	The MDSS HIMAX LCD Panel support
	
config FB_MSM_MDSS_BOE_WXGA_PANEL
	bool "MDSS BOE WXGA Panel"
	default n
	---help---
	The MDSS BOE LCD Panel support
	
config ESD_ERR_FG_RECOVERY
	bool "ESD Feature"
	default n

config FB_MSM_MDSS_SDC_WXGA_PANEL
	bool "MDSS SDC WXGA Panel"
	default n
	---help---
	The MDSS SDC LCD Panel support

config LCD_CONNECTION_CHECK
	bool "check if LCD connected or not and detect panel vendor"
	default n

config SAMSUNG_DEBUG_DISPLAY 
	bool "Add Samsung Debugging code"
	default n

config FB_MSM_MDSS_KTD3102_BACKLIGHT
	bool "MDSS KTD3102 Backlight IC"
	default n
	
config FB_MSM_MDSS_BOE_HD_PANEL
	bool "MDSS BOE HD Panel"
	default n
	---help---
	The MDSS BOE LCD Panel support
config TCON_MDNIE_LITE
	bool "Tcon MDNIe lite support"
	default n	
```
