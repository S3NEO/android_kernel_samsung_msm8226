## arch/arm/configs/msm8226-sec_craterve3g_ctc_defconfig
```kconfig
#RTCC
CONFIG_SWAP=y
CONFIG_ZRAM=y
CONFIG_ZRAM_DEBUG=y
CONFIG_ZRAM_FOR_ANDROID=y

#variant defconfig
CONFIG_MACH_CRATERVE_CHN_CTC=y

#Debug
# CONFIG_ANDROID_RAM_CONSOLE is not set
CONFIG_SEC_LOG_LAST_KMSG=y
CONFIG_SEC_DEBUG_NOCACHE_LOG_IN_LEVEL_LOW=y
#VIBARTOR
CONFIG_QPNP_VIBRATOR=y
CONFIG_MSM_VIBRATOR=y

#LCD
CONFIG_FB_MSM_MDSS_HIMAX_QHD_PANEL=y
CONFIG_ESD_ERR_FG_RECOVERY=y
CONFIG_FB_MSM_MDSS=y
CONFIG_FB_MSM_MDSS_WRITEBACK=y
CONFIG_BACKLIGHT_LCD_SUPPORT=y
CONFIG_MDNIE_LITE_TUNING=y
CONFIG_LCD_CLASS_DEVICE=y
CONFIG_BACKLIGHT_CLASS_DEVICE=y
CONFIG_LCD_CONNECTION_CHECK=y
# CONFIG_BACKLIGHT_GENERIC is not set
CONFIG_FB_MSM_MDSS_KTD3102_BACKLIGHT=y

#TOUCH
CONFIG_TOUCHSCREEN_MMS152=n
CONFIG_TOUCHSCREEN_BCMTCH15XXX=n
CONFIG_TOUCHSCREEN_ZINITIX_BT531=n
CONFIG_TOUCHSCREEN_ZINITIX_BT532=n
CONFIG_TOUCHSCREEN_ZINITIX_CRATERQ=y
CONFIG_KEYBOARD_CYPRESS_TOUCH=n

#USB
CONFIG_USB_ANDROID_SAMSUNG_COMPOSITE=y
CONFIG_USB_ANDROID_SAMSUNG_MTP=y
CONFIG_USB_DUN_SUPPORT=y
CONFIG_USB_HOST_NOTIFY=y

#MUIC
CONFIG_USB_SWITCH_TSU6721=y
CONFIG_SM5502_MUIC=y

#SENSORS
CONFIG_SENSORS_CORE=y
CONFIG_INPUT_YAS_SENSORS=n
CONFIG_YAS_ACC_MULTI_SUPPORT=n
CONFIG_INPUT_YAS_ACCELEROMETER=n
CONFIG_YAS_ACC_DRIVER_BMA250=n
CONFIG_SENSORS_HSCDTD008A=y
CONFIG_INPUT=y
CONFIG_INPUT_GPIO=y
CONFIG_INPUT_POLLDEV=y
CONFIG_INPUT_MPU6500=y
CONFIG_INPUT_MPU6500_SELFTEST=y
CONFIG_INPUT_MPU6500_POLLING=y
CONFIG_BMA250_ACC_DRIVER=n
CONFIG_SENSORS_HALL=n


#CAMERA
CONFIG_FB_MSM_CAMERA_CSC=y
CONFIG_S5K3H5XA=y
CONFIG_S5K4H5YA=y
CONFIG_S5K4H5YB=y
CONFIG_S5K6A3YX=y
CONFIG_SR200PC20=y

#Battery
CONFIG_QPNP_SEC_CHARGER=y
CONFIG_BATTERY_BCL=y
CONFIG_QPNP_BMS=y

#configs for ppp
CONFIG_PPP_FILTER=y
CONFIG_PPP_MPPE=y
CONFIG_PPPOLAC=y
CONFIG_PPPOPNS=y

#WIFI
#no need

#BT
#no need

#NFC
CONFIG_BCM2079X_NFC_I2C=y

# Earjack
CONFIG_SAMSUNG_JACK=y
# QCOM DEBUG
CONFIG_MSM_RTB=y 
CONFIG_MSM_RTB_SEPARATE_CPUS=y 

# SAPA
CONFIG_RTC_AUTO_PWRON=y
CONFIG_RTC_AUTO_PWRON_PARAM=y
# DO NOT EXT OVP
CONFIG_NOT_USE_EXT_OVP=y

#SEC OOM KILLER
CONFIG_SEC_OOM_KILLER=y
```

## arch/arm/configs/msm8226-sec_millet3g_defconfig
```kconfig
#variant defconfig
CONFIG_MACH_MILLET3G_EUR=y

#CONFIG_FB_MSM_MDSS_SHARP_HD_PANEL=y
CONFIG_FB_MSM_MDSS_SDC_WXGA_PANEL=y
#CONFIG_ESD_ERR_FG_RECOVERY=y
CONFIG_FB_MSM_MDSS=y
CONFIG_FB_MSM_MDSS_WRITEBACK=y
CONFIG_BACKLIGHT_LCD_SUPPORT=y
CONFIG_MDNIE_LITE_TUNING=y
CONFIG_LCD_CLASS_DEVICE=y
CONFIG_BACKLIGHT_CLASS_DEVICE=y
# CONFIG_BACKLIGHT_GENERIC is not set

#VIBRATOR
#CONFIG_QPNP_VIBRATOR is not set
CONFIG_MSM_VIBRATOR=y

#TSP
CONFIG_TOUCHSCREEN_MMS252=y
#CONFIG_TOUCHSCREEN_BCMTCH15XXX is not set
#CONFIG_KEYBOARD_CYPRESS_TOUCH is not set

#SENSOR
CONFIG_SENSORS_CORE=y
CONFIG_INPUT_YAS_SENSORS=y
CONFIG_YAS_ACC_MULTI_SUPPORT=y
CONFIG_INPUT_YAS_ACCELEROMETER=y
CONFIG_YAS_ACC_DRIVER_BMA250=y
CONFIG_INPUT_YAS_ACCELEROMETER_POSITION=1
CONFIG_SENSORS_K3DH=y
CONFIG_SENSOR_K3DH_INPUTDEV=y
CONFIG_SENSORS_CM36653=y
CONFIG_PROXIMITY_SENSOR=y
CONFIG_OPTICAL_TAOS_TMD2672X=y
CONFIG_SENSORS_ASP01=y
CONFIG_SENSORS_HSCDTD008A=y
CONFIG_INPUT=y
CONFIG_INPUT_GPIO=y
CONFIG_INPUT_POLLDEV=y
CONFIG_INPUT_MPU6500=y
CONFIG_INPUT_MPU6500_SELFTEST=y
CONFIG_INPUT_MPU6500_POLLING=y
CONFIG_SENSORS_HALL=y

#CAMERA
CONFIG_MSM_CPP=y
#CONFIG_S5K3H5XA=y
#CONFIG_S5K4H5YB=y
#CONFIG_S5K6A3YX=y
#CONFIG_ISX012=y
CONFIG_SR352=y
CONFIG_SR130PC20=y

#USB
CONFIG_USB_ANDROID_SAMSUNG_COMPOSITE=y
CONFIG_USB_ANDROID_SAMSUNG_MTP=y
CONFIG_USB_DUN_SUPPORT=y
CONFIG_USB_HOST_NOTIFY=y
CONFIG_USB_STORAGE_DETECT=y

#MUIC
CONFIG_MFD_MAX77693=y
CONFIG_USB_SWITCH_MAX77693=y
CONFIG_REGULATOR_MAX77693=y
CONFIG_DI_MUIC=n
CONFIG_MUIC_INIT_DETECT_DELAY=3000
CONFIG_MUIC_USB_DETECT_DELAY=17000

# IRDA support
CONFIG_IR_REMOCON_MC96=y

# MAX77803 Charger
CONFIG_BATTERY_SAMSUNG=y
CONFIG_SAMSUNG_LPM_MODE=y
CONFIG_FUELGAUGE_MAX17050=y
CONFIG_FUELGAUGE_MAX17050_COULOMB_COUNTING=y
CONFIG_CHARGER_MAX77693=y

#BT
no need

#Wifi
no need

# Earjack
CONFIG_SAMSUNG_JACK=y
```

## arch/arm/configs/msm8226-sec_ms013g_chncmcc_defconfig
```kconfig
#variant defconfig
CONFIG_MACH_MS01_CHN_CMCC_3G=y
# CONFIG_MACH_MS01 is not set

#Power off Alarm
CONFIG_RTC_AUTO_PWRON=y
CONFIG_RTC_AUTO_PWRON_PARAM=y

#WLAN CHN
CONFIG_TARGET_LOCALE_CHN=y
CONFIG_WLAN_REGION_CODE=300

#VIBARTOR
CONFIG_QPNP_VIBRATOR=y
CONFIG_MSM_VIBRATOR=y


#LCD
CONFIG_FB_MSM_MDSS_SHARP_HD_PANEL=y
# CONFIG_ESD_ERR_FG_RECOVERY=y
CONFIG_FB_MSM_MDSS=y
CONFIG_FB_MSM_MDSS_WRITEBACK=y
CONFIG_BACKLIGHT_LCD_SUPPORT=y
CONFIG_MDNIE_LITE_TUNING=y
CONFIG_LCD_CLASS_DEVICE=y
CONFIG_BACKLIGHT_CLASS_DEVICE=y
# CONFIG_BACKLIGHT_GENERIC is not set

#TOUCH
CONFIG_TOUCHSCREEN_MMS152=y
CONFIG_TOUCHSCREEN_BCMTCH15XXX=y
CONFIG_TOUCHSCREEN_ZINITIX_BT531=y
CONFIG_KEYBOARD_CYPRESS_TOUCH=y

#USB
CONFIG_USB_ANDROID_SAMSUNG_COMPOSITE=y
CONFIG_USB_ANDROID_SAMSUNG_MTP=y
CONFIG_USB_DUN_SUPPORT=y
CONFIG_USB_HOST_NOTIFY=y

#MUIC
CONFIG_USB_SWITCH_TSU6721=y

#SENSORS
CONFIG_SENSORS_CORE=y
CONFIG_INPUT_YAS_SENSORS=y
CONFIG_YAS_ACC_MULTI_SUPPORT=y
CONFIG_INPUT_YAS_ACCELEROMETER=y
CONFIG_YAS_ACC_DRIVER_BMA250=y
CONFIG_INPUT_YAS_ACCELEROMETER_POSITION=1
CONFIG_SENSORS_HSCDTD008A=y
CONFIG_INPUT=y
CONFIG_INPUT_GPIO=y
CONFIG_INPUT_POLLDEV=y
CONFIG_INPUT_MPU6500=y
CONFIG_INPUT_MPU6500_SELFTEST=y
CONFIG_INPUT_MPU6500_POLLING=y
CONFIG_SENSORS_HALL=y


#CAMERA
CONFIG_S5K3H5XA=y
CONFIG_S5K4H5YA=y
CONFIG_S5K4H5YB=y
CONFIG_S5K6A3YX=y


#Battery
CONFIG_QPNP_SEC_CHARGER=y
CONFIG_BATTERY_BCL=y
CONFIG_QPNP_BMS=y

#WIFI
#no need

#BT
#no need

# Earjack
CONFIG_SAMSUNG_JACK=y
```

## arch/arm/configs/msm8226-sec_ms013g_ctc_defconfig
```kconfig
#RTCC
CONFIG_SWAP=y
CONFIG_ZRAM=y
CONFIG_ZRAM_DEBUG=y
CONFIG_ZRAM_FOR_ANDROID=y

#variant defconfig
CONFIG_MACH_MS01_CHN_CTC=y
# CONFIG_MACH_MS01 is not set

#VIBARTOR
CONFIG_QPNP_VIBRATOR=y
CONFIG_MSM_VIBRATOR=y

#LCD
CONFIG_FB_MSM_MDSS_SHARP_HD_PANEL=y
CONFIG_ESD_ERR_FG_RECOVERY=y
CONFIG_FB_MSM_MDSS=y
CONFIG_FB_MSM_MDSS_WRITEBACK=y
CONFIG_BACKLIGHT_LCD_SUPPORT=y
CONFIG_MDNIE_LITE_TUNING=y
CONFIG_LCD_CLASS_DEVICE=y
CONFIG_BACKLIGHT_CLASS_DEVICE=y
CONFIG_LCD_CONNECTION_CHECK=y
# CONFIG_BACKLIGHT_GENERIC is not set

#TOUCH
CONFIG_TOUCHSCREEN_MMS152=y
CONFIG_TOUCHSCREEN_BCMTCH15XXX=y
CONFIG_TOUCHSCREEN_ZINITIX_BT531=y
CONFIG_KEYBOARD_CYPRESS_TOUCH=y

#USB
CONFIG_USB_ANDROID_SAMSUNG_COMPOSITE=y
CONFIG_USB_ANDROID_SAMSUNG_MTP=y
CONFIG_USB_DUN_SUPPORT=y
CONFIG_USB_HOST_NOTIFY=y

#MUIC
CONFIG_USB_SWITCH_TSU6721=y

#SENSORS
CONFIG_SENSORS_CORE=y
CONFIG_INPUT_YAS_SENSORS=n
CONFIG_YAS_ACC_MULTI_SUPPORT=n
CONFIG_INPUT_YAS_ACCELEROMETER=n
CONFIG_YAS_ACC_DRIVER_BMA250=n
CONFIG_SENSORS_HSCDTD008A=y
CONFIG_INPUT=y
CONFIG_INPUT_GPIO=y
CONFIG_INPUT_POLLDEV=y
CONFIG_INPUT_MPU6500=n
CONFIG_INPUT_MPU6500_SELFTEST=n
CONFIG_INPUT_MPU6500_POLLING=n
CONFIG_BMA250_ACC_DRIVER=y
CONFIG_SENSORS_HALL=y


#CAMERA
CONFIG_S5K3H5XA=y
CONFIG_S5K4H5YA=y
CONFIG_S5K4H5YB=y
CONFIG_S5K6A3YX=y


#Battery
CONFIG_QPNP_SEC_CHARGER=y
CONFIG_BATTERY_BCL=y
CONFIG_QPNP_BMS=y

#configs for ppp
CONFIG_PPP_FILTER=y
CONFIG_PPP_MPPE=y
CONFIG_PPPOLAC=y
CONFIG_PPPOPNS=y

#WIFI
#no need

#BT
#no need

#NFC
CONFIG_BCM2079X_NFC_I2C=y

# Earjack
CONFIG_SAMSUNG_JACK=y
# QCOM DEBUG
CONFIG_MSM_RTB=y 
CONFIG_MSM_RTB_SEPARATE_CPUS=y 

# SAPA
CONFIG_RTC_AUTO_PWRON=y
CONFIG_RTC_AUTO_PWRON_PARAM=y

# DO NOT EXT OVP
CONFIG_NOT_USE_EXT_OVP=y
```

## arch/arm/configs/msm8226-sec_s3lite3g_chnctc_defconfig
```kconfig
#RTCC
CONFIG_SWAP=y
CONFIG_ZRAM=y
CONFIG_ZRAM_DEBUG=y
CONFIG_ZRAM_FOR_ANDROID=y

#variant defconfig
CONFIG_MACH_S3VECTC=y
CONFIG_MACH_S3VE_CHN_CTC=y

# CONFIG_MACH_MS01 is not set

#Debug
# CONFIG_ANDROID_RAM_CONSOLE is not set
CONFIG_SEC_LOG_LAST_KMSG=y
CONFIG_SEC_DEBUG_NOCACHE_LOG_IN_LEVEL_LOW=y

#WLAN CHN
CONFIG_TARGET_LOCALE_CHN=y
CONFIG_WLAN_REGION_CODE=300

#VIBARTOR
# CONFIG_QPNP_VIBRATOR is not set
# CONFIG_MSM_VIBRATOR is not set
#CONFIG_VIBETONZ is not set
CONFIG_MOTOR_DRV_DRV2603=y

#LCD
CONFIG_FB_MSM_MDSS_S6E8AA0A_HD_PANEL=y
CONFIG_ESD_ERR_FG_RECOVERY=y
CONFIG_FB_MSM_MDSS=y
CONFIG_FB_MSM_MDSS_WRITEBACK=y
CONFIG_BACKLIGHT_LCD_SUPPORT=y
CONFIG_MDNIE_VIDEO_ENHANCED=y
CONFIG_LCD_CLASS_DEVICE=y
CONFIG_BACKLIGHT_CLASS_DEVICE=y
CONFIG_LCD_CONNECTION_CHECK=y
# CONFIG_BACKLIGHT_GENERIC is not set

#SvcLED
CONFIG_LEDS_AN30259A=y

#TOUCH
CONFIG_TOUCHSCREEN_MMS152=n
CONFIG_TOUCHSCREEN_BCMTCH15XXX=n
CONFIG_TOUCHSCREEN_ZINITIX_BT531=n
CONFIG_KEYBOARD_CYPRESS_TOUCH=n
CONFIG_KEYBOARD_CYPRESS_TOUCH_236=y
CONFIG_TOUCHSCREEN_MMS144=y

#USB
CONFIG_USB_ANDROID_SAMSUNG_COMPOSITE=y
CONFIG_USB_ANDROID_SAMSUNG_MTP=y
CONFIG_USB_DUN_SUPPORT=y
CONFIG_USB_HOST_NOTIFY=y

#MUIC
CONFIG_USB_SWITCH_TSU6721=y
CONFIG_SM5502_MUIC=y

#SENSORS
CONFIG_SENSORS_CORE=y
CONFIG_INPUT_YAS_SENSORS=y
CONFIG_YAS_MAG_MULTI_SUPPORT=y
#CONFIG_INPUT_YAS_ACCELEROMETER is not set
CONFIG_INPUT_YAS_MAGNETOMETER=y
#CONFIG_YAS_ACC_DRIVER_BMA250 is not set
CONFIG_INPUT_YAS_MAGNETOMETER_POSITION=3
#CONFIG_SENSORS_HSCDTD008A is not set
CONFIG_SENSORS_CM36651=y
CONFIG_INPUT=y
CONFIG_INPUT_GPIO=y
CONFIG_INPUT_POLLDEV=y
CONFIG_INPUT_MPU6500=y
CONFIG_INPUT_MPU6500_SELFTEST=y
CONFIG_INPUT_MPU6500_POLLING=y
CONFIG_SENSORS_HALL=y
#CONFIG_SENSORS_HALL is not set
CONFIG_YAS_MAG_DRIVER_YAS532=y
#CAMERA
CONFIG_S5K3H5XA=y
CONFIG_S5K4H5YA=y
CONFIG_S5K4H5YB=y
CONFIG_S5K6A3YX=y

#Battery
CONFIG_QPNP_SEC_CHARGER=y
CONFIG_BATTERY_BCL=y
CONFIG_QPNP_BMS=y

# SAPA
CONFIG_RTC_AUTO_PWRON=y
CONFIG_RTC_AUTO_PWRON_PARAM=y

# DO NOT EXT OVP
CONFIG_NOT_USE_EXT_OVP=y

#WIFI
CONFIG_WCNSS_CCX=y

#NFC
CONFIG_BCM2079X_NFC_I2C=y

#BT
#no need

# Earjack
CONFIG_SAMSUNG_JACK=y
# QCOM DEBUG
CONFIG_MSM_RTB=y
CONFIG_MSM_RTB_SEPARATE_CPUS=y

#configs for ppp
CONFIG_PPP_FILTER=y
CONFIG_PPP_ASYNC=y
CONFIG_PPP_SYNC_TTY=y

#SEC OOM KILLER
CONFIG_SEC_OOM_KILLER=y
```

## arch/arm/configs/msm8226-sec_s3ve3g_chncmcc_defconfig
```kconfig
#variant defconfig
CONFIG_MACH_S3VE=y
CONFIG_MACH_S3VE_CHN_CMCC=y

# CONFIG_MACH_MS01 is not set

#WLAN CHN
CONFIG_TARGET_LOCALE_CHN=y
CONFIG_WLAN_REGION_CODE=300

#VIBARTOR
CONFIG_QPNP_VIBRATOR=y
CONFIG_MSM_VIBRATOR=y

#LCD
CONFIG_FB_MSM_MDSS_S6E8AA0A_HD_PANEL=y
#CONFIG_ESD_ERR_FG_RECOVERYis not set
CONFIG_FB_MSM_MDSS=y
CONFIG_FB_MSM_MDSS_WRITEBACK=y
CONFIG_BACKLIGHT_LCD_SUPPORT=y
# CONFIG_MDNIE_LITE_TUNING is not set
CONFIG_LCD_CLASS_DEVICE=y
CONFIG_BACKLIGHT_CLASS_DEVICE=y
# CONFIG_LCD_CONNECTION_CHECK is not set
# CONFIG_BACKLIGHT_GENERIC is not set

#SvcLED
CONFIG_LEDS_AN30259A=y

#TOUCH
CONFIG_TOUCHSCREEN_MMS152=n
CONFIG_TOUCHSCREEN_BCMTCH15XXX=n
CONFIG_TOUCHSCREEN_ZINITIX_BT531=n
CONFIG_KEYBOARD_CYPRESS_TOUCH=n
CONFIG_KEYBOARD_CYPRESS_TOUCH_236=y
CONFIG_TOUCHSCREEN_MMS144=y

#USB
CONFIG_USB_ANDROID_SAMSUNG_COMPOSITE=y
CONFIG_USB_ANDROID_SAMSUNG_MTP=y
CONFIG_USB_DUN_SUPPORT=y
CONFIG_USB_HOST_NOTIFY=y

#MUIC
CONFIG_USB_SWITCH_TSU6721=y

#SENSORS
CONFIG_SENSORS_CORE=y
CONFIG_INPUT_YAS_SENSORS=y
CONFIG_YAS_MAG_MULTI_SUPPORT=y
#CONFIG_INPUT_YAS_ACCELEROMETER is not set
CONFIG_INPUT_YAS_MAGNETOMETER=y
#CONFIG_YAS_ACC_DRIVER_BMA250 is not set
CONFIG_INPUT_YAS_MAGNETOMETER_POSITION=3
#CONFIG_SENSORS_HSCDTD008A is not set
CONFIG_SENSORS_CM36651=y
CONFIG_INPUT=y
CONFIG_INPUT_GPIO=y
CONFIG_INPUT_POLLDEV=y
CONFIG_INPUT_MPU6500=y
CONFIG_INPUT_MPU6500_SELFTEST=y
CONFIG_INPUT_MPU6500_POLLING=y
#CONFIG_SENSORS_HALL is not set
CONFIG_YAS_MAG_DRIVER_YAS532=y
#CAMERA
CONFIG_S5K3H5XA=y
CONFIG_S5K4H5YA=y
CONFIG_S5K4H5YB=y
CONFIG_S5K6A3YX=y


#Battery
CONFIG_QPNP_SEC_CHARGER=y
CONFIG_BATTERY_BCL=y
CONFIG_QPNP_BMS=y

#WIFI
#no need

#BT
#no need

# Earjack
CONFIG_SAMSUNG_JACK=y
# QCOM DEBUG
CONFIG_MSM_RTB=y 
CONFIG_MSM_RTB_SEPARATE_CPUS=y 
```

## arch/arm/configs/msm8926-sec_hlitelte_chnctc_defconfig
```kconfig
#variant defconfig
CONFIG_MACH_MS01_LTE=y
CONFIG_MACH_HLITE_CHN_SGLTE=y
CONFIG_MACH_HLITE_CHN_SGLTE_CTC=y

#Battery
#CONFIG_QPNP_SEC_CHARGER is not set
CONFIG_QPNP_BMS=y
CONFIG_BATTERY_BCL=y
CONFIG_BATTERY_SAMSUNG=y
CONFIG_SAMSUNG_LPM_MODE=y
CONFIG_CHARGER_SMB358=y

#Do not use external OVP
CONFIG_NOT_USE_EXT_OVP=y

#LCD
CONFIG_FB_MSM_MDSS_MAGNA_OCTA_720P_PANEL=y
CONFIG_ESD_ERR_FG_RECOVERY=y
CONFIG_FB_MSM_MDSS=y
CONFIG_FB_MSM_MDSS_WRITEBACK=y
CONFIG_BACKLIGHT_LCD_SUPPORT=y
#CONFIG_MDNIE_LITE_TUNING=y
CONFIG_MDNIE_VIDEO_ENHANCED=y
CONFIG_LCD_CLASS_DEVICE=y
CONFIG_BACKLIGHT_CLASS_DEVICE=y
CONFIG_LCD_CONNECTION_CHECK=y
#CONFIG_BACKLIGHT_GENERIC is not set

#SvcLED
CONFIG_LEDS_AN30259A=y

#TOUCH
CONFIG_TOUCHSCREEN_MMS152=n
CONFIG_TOUCHSCREEN_BCMTCH15XXX=n
CONFIG_KEYBOARD_CYPRESS_TKEY_20055=y
CONFIG_TOUCHSCREEN_ZINITIX_BT531=n
CONFIG_TOUCHSCREEN_FTS=y
CONFIG_GLOVE_TOUCH=y
#CONFIG_INPUT_BOOSTER=y

#E-PEN
CONFIG_INPUT_WACOM=y
CONFIG_EPEN_WACOM_G9PM=y

#VIBARTOR
# CONFIG_QPNP_VIBRATOR is not set
# CONFIG_MSM_VIBRATOR is not set
#CONFIG_VIBETONZ is not set
CONFIG_MOTOR_DRV_DRV2603=y

#HallSensor
CONFIG_SENSORS_HALL=y

#USB
CONFIG_USB_ANDROID_SAMSUNG_COMPOSITE=y
CONFIG_USB_ANDROID_SAMSUNG_MTP=y
CONFIG_USB_HOST_NOTIFY=y
CONFIG_USB_DUN_SUPPORT=y
CONFIG_USB_STORAGE_DETECT=y
CONFIG_USB_PRINTER=y


#MUIC
CONFIG_USB_SWITCH_TSU6721=n
CONFIG_SM5502_MUIC=y

#SENSORS
CONFIG_INPUT=y
CONFIG_INPUT_GPIO=y
CONFIG_INPUT_POLLDEV=y
#CONFIG_SENSORS_CORE=y
CONFIG_SENSORS_INVENSENSE=y
CONFIG_SENSORS_TMD27723=y
CONFIG_SENSORS_AK09911C=y
#CONFIG_INPUT_MPU6500 is not set
CONFIG_INPUT_MPU6500_SELFTEST=y
#CONFIG_INPUT_MPU6500_POLLING is not set
# MPL start
CONFIG_SYSFS=y
CONFIG_STAGING=y
CONFIG_INV_MPU_IIO=y
CONFIG_IIO_SW_RING=y
CONFIG_IIO_ST_HWMON=y
CONFIG_IIO=y
CONFIG_IIO_KFIFO_BUF=y
CONFIG_IIO_TRIGGER=y
CONFIG_IIO_BUFFER=y
# MPL end
#NFC
CONFIG_BCM2079X_NFC_I2C=y
CONFIG_NFC_PN544=n
CONFIG_SEC_NFC_I2C=n

#CAMERA
CONFIG_S5K3H5XA=y
CONFIG_S5K4H5YA=y
CONFIG_S5K4H5YB=y
CONFIG_S5K6A3YX=y
CONFIG_S5K6B2YX=y

#W1
CONFIG_W1=y
CONFIG_W1_MASTER_GPIO_MSM=y
CONFIG_W1_SLAVE_DS28EL15=y

#WIFI
#no need

#BT
#no need

# Earjack
CONFIG_SAMSUNG_JACK=y

# SAPA
CONFIG_RTC_AUTO_PWRON=y
CONFIG_RTC_AUTO_PWRON_PARAM=y
```

## arch/arm/configs/msm8926-sec_ms01lte_chncmcc_defconfig
```kconfig
#variant defconfig
CONFIG_MACH_MS01_LTE=y
CONFIG_MACH_MS01_CHN_SGLTE=y

#Battery
CONFIG_QPNP_SEC_CHARGER=y
CONFIG_QPNP_BMS=y
CONFIG_BATTERY_BCL=y
CONFIG_CMCC_MTBF_CHG_BLOCK=y

#Do not use external OVP
CONFIG_NOT_USE_EXT_OVP=y

#LCD
CONFIG_FB_MSM_MDSS_SHARP_HD_PANEL=y
CONFIG_ESD_ERR_FG_RECOVERY=y
CONFIG_FB_MSM_MDSS=y
CONFIG_FB_MSM_MDSS_WRITEBACK=y
CONFIG_BACKLIGHT_LCD_SUPPORT=y
CONFIG_MDNIE_LITE_TUNING=y
CONFIG_LCD_CLASS_DEVICE=y
CONFIG_BACKLIGHT_CLASS_DEVICE=y
CONFIG_LCD_CONNECTION_CHECK=y
#CONFIG_BACKLIGHT_GENERIC is not set

#TOUCH
CONFIG_TOUCHSCREEN_MMS152=y
CONFIG_TOUCHSCREEN_BCMTCH15XXX=y
CONFIG_KEYBOARD_CYPRESS_TOUCH=y
CONFIG_TOUCHSCREEN_ZINITIX_BT531=y

#Vibrator
CONFIG_MSM_VIBRATOR=y
CONFIG_QPNP_VIBRATOR=y

#HallSensor
CONFIG_SENSORS_HALL=y

#USB
CONFIG_USB_ANDROID_SAMSUNG_COMPOSITE=y
CONFIG_USB_ANDROID_SAMSUNG_MTP=y
CONFIG_USB_HOST_NOTIFY=y
CONFIG_USB_DUN_SUPPORT=y


#MUIC
CONFIG_USB_SWITCH_TSU6721=n
CONFIG_SM5502_MUIC=y

#SENSORS
CONFIG_SENSORS_CORE=y
CONFIG_SENSORS_HSCDTD008A=y
CONFIG_BMA250_ACC_DRIVER=y
CONFIG_INPUT=y
CONFIG_INPUT_GPIO=y
CONFIG_INPUT_POLLDEV=y



#CAMERA
CONFIG_S5K3H5XA=y
CONFIG_S5K4H5YA=y
CONFIG_S5K4H5YB=y
CONFIG_S5K6A3YX=y

#WIFI
CONFIG_TARGET_LOCALE_CHN=y
CONFIG_WLAN_REGION_CODE=300

#BT
#no need

# Earjack
CONFIG_SAMSUNG_JACK=y

# SAPA
CONFIG_RTC_AUTO_PWRON=y
CONFIG_RTC_AUTO_PWRON_PARAM=y
```
